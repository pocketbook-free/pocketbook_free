## kernel_070611/arch/arm/mach-s3c6410/Kconfig
```kconfig
# arch/arm/mach-s3c6410/Kconfig
#
# Copyright 2008 Openmoko, Inc.
# Copyright 2008 Simtec Electronics
#
# Licensed under GPLv2

# Configuration options for the S3C6410 CPU

config CPU_S3C6410
	bool
	select CPU_S3C64XX_INIT
	select CPU_S3C64XX_CLOCK
	help
	  Enable S3C6410 CPU support

config S3C6410_SETUP_SDHCI
	bool
	help
	  Internal helper functions for S3C6410 based SDHCI systems

# menu "Samsung S3C6410 Implementations"

choice
	prompt "Select Machine"

config MACH_SMDK6410
	bool "SMDK6410"
	select CPU_S3C6410
	select S3C_DEV_HSMMC
	select S3C_DEV_HSMMC1
        select S3C_DEV_HSMMC2
	select S3C_DEV_I2C1
	select S3C6410_SETUP_SDHCI
	select S3C64XX_SETUP_I2C1
	select S3C_DMA_PL080
	help
	  Machine support for the Samsung SMDK6410


endchoice

# At least some of the SMDK6410s were shipped with the card detect
# for the MMC/SD slots connected to the same input. This means that
# either the boards need to be altered to have channel0 to an alternate
# configuration or that only one slot can be used.

menu  "S3C6410 MMC/SD slot setup"
	depends on MACH_SMDK6410

config S3C6410_SD_CH0
	bool "Use channel 0 (Internal SD)"
	depends on MACH_SMDK6410
	help
          Select CON7 (channel 0) as the MMC/SD slot, as
	  at least some SMDK6410 boards come with the
	  resistors fitted so that the card detects for
	  channels 0 and 1 are the same.
       
config S3C6410_SD_CH1
	bool "Use channel 1 (External SD)"
	depends on MACH_SMDK6410
	help
          Select CON6 (channel 1) as the MMC/SD slot, as
	  at least some SMDK6410 boards come with the
	  resistors fitted so that the card detects for
	  channels 0 and 1 are the same.

config S3C6410_SD_CH2
	bool "Use channel 2 (WLAN SDIO)"
	depends on MACH_SMDK6410
	help
          WLAN SDIO Interface
          
endmenu

choice
	prompt "SMDK6410 Revision"
	depends on MACH_SMDK6410

config SMDK6410_REV02
	bool "SMDK6410 Rev0.2"
	depends on MACH_SMDK6410
	help
	  Select SMDK6410 sub revision number 

config SMDK6410_REV10
	bool "SMDK6410 Rev1.0"
	select TOUCHSCREEN_NEW
	depends on MACH_SMDK6410
	help
	  Select SMDK6410 sub revision number 

endchoice

choice
	prompt "SMDK6410 RAM Size"
	depends on MACH_SMDK6410

config SMDK6410_RAMSIZE_256M
	bool "SMDK6410 RAM 256M"
	depends on MACH_SMDK6410
	help
	  Select SMDK6410 internal ram size 

config SMDK6410_RAMSIZE_128M
	bool "SMDK6410_RAM_128M"
	depends on MACH_SMDK6410
	help
	  Select SMDK6410 internal ram size

endchoice

menu   "EP1 HARDWARE VERSION SELECT"

config HW_EP1_EVT
	bool "EP1 Hardware version( EVT )"
	help
	  Select EP1 hardware version

config HW_EP1_EVT2
	bool "EP1 Hardware version( EVT2 )"
	help
	  Select EP1 hardware version
	  
config HW_EP1_DVT
	bool "EP1 Hardware version( DVT )"
	help
	  Select EP1 hardware version

endmenu
menu   "EP2 HARDWARE VERSION SELECT"

config HW_EP2_EVT
	bool "EP2 Hardware version( EVT )"
	help
	  Select EP2 hardware version

config HW_EP2_EVT2
	bool "EP2 Hardware version( EVT2 )"
	help
	  Select EP2 hardware version
	  
config HW_EP2_DVT
	bool "EP2 Hardware version( DVT )"
	help
	  Select EP2 hardware version

endmenu

menu   "EP3 HARDWARE VERSION SELECT"

config HW_EP3_EVT
	bool "EP3 Hardware version( EVT )"
	help
	  Select EP3 hardware version
	
config HW_EP3_EVT2
	bool "EP3 Hardware version( EVT2 )"
	help
	  Select EP3 hardware version

config HW_EP3_DVT
	bool "EP3 Hardware version( DVT )"
	help
	  Select EP3 hardware version

endmenu
menu	"EP4 HARDWARE VERSION SELECT"

config HW_EP4_EVT
	bool "EP4 Hardware version( EVT )"
	help
	  Select EP4 hardware version

config HW_EP4_EVT2
	bool "EP4 Hardware version( EVT2 )"
	help
	  Select EP4 hardware version


config HW_EP4_DVT
	bool "EP4 Hardware version( DVT )"
	help
	  Select EP4 hardware version

endmenu

config STOP_MODE_SUPPORT
	bool "Stop Mode Support (for S3C6410 only)"
	depends on MACH_SMDK6410
	help
	  S3C6410 Stop mode support
```

## kernel_070611/drivers/hallsensor/Kconfig
```kconfig
#menu "Sensors Driver support"

config SENSORS_HALL
	bool "HALL Sensor support"
	default n
	help
	  Say Y here if you have an applicable e-book and want to experience
	  the awesome irq of hall sensor.  
#endmenu
```

## kernel_070611/drivers/input/sensor/Kconfig
```kconfig
menuconfig INPUT_SENSOR
	bool "sensor driver as the input device"
	default y
	help
	  Say Y here, and a list of supported sensor will be displayed.
	  This option doesn't affect the kernel.

	  If unsure, say Y.
if INPUT_SENSOR
config GSENSOR_ADXL345
	 bool "ADXL345 Gsensor support"
	default y
	help 
	  support the adxl345 gsensor 
config GSENSOR_BMA020
	bool "BMA020 Gsensor support"
	help
	   support the bma020 sensor
endif
```

## kernel_070611/drivers/video/eink/Kconfig
```kconfig
#
# eInk configuration
#

config FB_EINK_LIBRARY
    bool "eInk Built-in Library"
    select FB_CFB_FILLRECT
    select FB_CFB_COPYAREA
    select FB_CFB_IMAGEBLIT
#	select FB_SYS_FILLRECT
#	select FB_SYS_COPYAREA
#	select FB_SYS_IMAGEBLIT
#	select FB_SYS_FOPS
    select ZLIB_INFLATE
    select ZLIB_DEFLATE
    default y

config FB_EINK
    tristate "eInk Umbrella Config (HAL & Legacy Shim)"
    depends on FB

config FB_EINK_SHIM
    tristate "eink Shim Driver (Legacy-to-HAL Bridge)"
    depends on FB_EINK

config FB_EINK_HAL
    tristate "eink HAL Umbrella Config"
    depends on FB_EINK

config FB_EINK_HAL_BROADSHEET
    tristate "eInk HAL Driver for the Broadsheet Controller"
    depends on FB_EINK_HAL
    # && ARCH_S3C6410
    
```

## kernel_070611/drivers/video/eink/epson.ntx/Kconfig
```kconfig
#
# Video configuration
#

menu "Epson S1D13521 Support (Netronix)"

config FB_EPSON_S1D13521
    tristate "S1D13521 Support"
    depends on FB
    select FB_CFB_FILLRECT
    select FB_CFB_COPYAREA
    select FB_CFB_IMAGEBLIT
    ---help---
      This enables support for Epson S1D13521 controller.

#config FB_EPSON_VIRTUAL_FRAMEBUFFER
#    bool "Support for virtual frame buffer"
#    depends on FB && FB_EPSON_S1D13521
#    select FB_CFB_FILLRECT
#    select FB_CFB_COPYAREA
#    select FB_CFB_IMAGEBLIT
#    ---help---
#      The frame buffer device provides an abstraction for the graphics

config FB_EPSON_BLACK_AND_WHITE
    bool "Black & White Virtual Framebuffer"
    depends on FB_EPSON_S1D13521
    ---help---
      Select Yes for Black & White Virtual Framebuffer, No for 8 shades of gray

config FB_EPSON_VIRTUAL_FRAMEBUFFER_FREQ
    depends on FB_EPSON_S1D13521
    int "Virtual Framebuffer update frequency (Hz)"
    default 4
    ---help---
      The virtual frame buffer update frequency

config FB_EPSON_PCI
    bool "EPSON PCI Support"
    depends on FB_EPSON_S1D13521 && PCI
    ---help---
      This enables support for Epson PCI evaluation boards

config FB_EPSON_GPIO_GUMSTIX
    bool "Assume Gumstix + GPIO pins"
    depends on FB_EPSON_S1D13521 && (!FB_EPSON_PCI)
    ---help---
      Select Yes if porting for the Gumstix/Broadsheet Platform, otherwise select No.

config FB_EPSON_NTX_EBOOK_2440
    bool "Assume NETRONIX eBook Device with S3C2440 SOC"
    depends on FB_EPSON_S1D13521 && (!FB_EPSON_PCI) && (!FB_EPSON_GPIO_GUMSTIX)
    ---help---
      Select Yes if porting for the Netronix eBook with S3C2440 SOC Platform, otherwise select No.

config FB_EPSON_HRDY_OK
    bool "The host interface supports HRDY signal"
    depends on FB_EPSON_S1D13521
    ---help---
      Select Yes if the host interface supports HRDY signal, otherwise select No.
      If the HRDY signal is not present, driver polls the register containing the
      interface status bit when neccessary.

config FB_EPSON_PROC
    bool "Create /proc device files"
    depends on FB_EPSON_S1D13521
    ---help---
      Enables registers i/o using procfs. Useful for debugging.

config FB_EPSON_DEBUG_PRINTK
    bool "Enable printk() debugging text."
    depends on FB_EPSON_S1D13521
    ---help---
      This enables printk() function in video driver.
      This function writes text to kernel log file when video driver
      functions are called. Note that printk() functions which display
      error messages are never disabled.

config FB_EPSON_SHOW_SETTINGS
    bool "Display configuration settings while compiling"
    depends on FB_EPSON_S1D13521
    ---help---
      At compile time, this shows video configuration settings as warning messages.

endmenu
```

## kernel_070611/sound/soc/s3c/Kconfig
```kconfig
config SND_S3C64XX_SOC
	tristate "Samsung SoC Audio"
	depends on ARCH_S3C64XX
	help
	  Say Y or M if you want to add support for codecs attached to
	  the S3C AC97, I2S or SSP interface. You will also need
	  to select the audio interfaces to support below.

config SND_S3C_I2S_V32
	tristate

config SND_S3C_I2S_V40
	tristate

config SND_S3C_I2S_V50
	tristate

config SND_S3C_AC97
	tristate

config SND_S3C6410_SOC_S3C_HEADSET
	tristate "S3C6410 Headset function"
	depends on SND_S3C64XX_SOC && (MACH_SMDK6410)	
	help
	  Say Y if you want to enable headset function on smdk6410

choice
	prompt "Select the codec driver"
	depends on SND_S3C64XX_SOC

config  SND_SMDK6410_WM8580
	tristate "WM8580-I2S on SMDK6410"
	depends on ARCH_S3C64XX
	select SND_S3C_I2S_V40
	select SND_SOC_WM8580

config  SND_SMDK6410_S5M8751
	tristate "S5M8751-I2S on SMDK6410"
	depends on SND_S3C64XX_SOC
	select SND_S3C_I2S_V32
	select SND_SOC_S5M8751

config  SND_SMDK6410_WM9713
	tristate "WM9713-AC97 on SMDK6410"
	depends on SND_S3C64XX_SOC
	select SND_S3C_AC97
	select SND_SOC_WM9713

config  SND_SMDK6410_WM8350
	tristate "WM8350-I2S on SMDK6410"
	depends on SND_S3C64XX_SOC
	select SND_S3C_I2S_V32
	select SND_SOC_WM8350

config  SND_SMDK6410_SSM2603
	tristate "SSM2603-I2S on SMDK6410"
	depends on SND_S3C64XX_SOC
	select SND_S3C_I2S_V32
	select SND_SOC_SSM2603

endchoice
```
